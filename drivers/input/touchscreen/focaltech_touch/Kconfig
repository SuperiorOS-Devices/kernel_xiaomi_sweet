## drivers/input/touchscreen/focaltech_touch/Kconfig
```kconfig
#
# Focaltech Touchscreen driver configuration
#

config TOUCHSCREEN_FTS_CAF
	tristate "Focaltech Touchscreen"
	help
	  Say Y here if you have Focaltech touch panel.
	  If unsure, say N.

config TOUCHSCREEN_FTS_CAF_DIRECTORY
	string "Focaltech ts directory name"
	default "focaltech_touch"
	depends on TOUCHSCREEN_FTS_CAF

config FTS_CAF_TRUSTED_TOUCH
	bool "Focaltech Trusted Touch"
	depends on TOUCHSCREEN_FTS_CAF
	help
	  Say Y here to enable Focaltech Trusted Touch.
	  If unsure, say N.

#endif
```
